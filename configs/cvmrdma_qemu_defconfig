## configs/cvmrdma_qemu_defconfig
```kconfig
BR2_x86_64=y
BR2_x86_x86_64_v3=y
BR2_TOOLCHAIN_EXTERNAL=y
BR2_TOOLCHAIN_EXTERNAL_PREINSTALLED=y
BR2_TOOLCHAIN_EXTERNAL_PATH="${HOME}/cvmrdma-install/toolchain-x86-64-v3"
BR2_PACKAGE_HOST_GDB=y
BR2_PACKAGE_HOST_GDB_TUI=y
BR2_PACKAGE_HOST_GDB_PYTHON3=y
BR2_GDB_VERSION_13=y
BR2_CCACHE=y
BR2_ENABLE_DEBUG=y
BR2_ENABLE_RUNTIME_DEBUG=y
BR2_ROOTFS_MERGED_USR=y
BR2_SYSTEM_BIN_SH_BASH=y
BR2_SYSTEM_DEFAULT_PATH="/bin:/sbin:/usr/bin:/usr/sbin"
BR2_ENABLE_LOCALE_WHITELIST="C.UTF-8"
BR2_GENERATE_LOCALE="C.UTF-8"
BR2_ROOTFS_OVERLAY="board/cvmrdma/cvm/rootfs_overlay"
BR2_ROOTFS_POST_BUILD_SCRIPT="board/cvmrdma/cvm/post-build.sh"
BR2_ROOTFS_POST_IMAGE_SCRIPT="board/cvmrdma/cvm/post-image.sh"
BR2_LINUX_KERNEL=y
BR2_LINUX_KERNEL_USE_CUSTOM_CONFIG=y
BR2_LINUX_KERNEL_CUSTOM_CONFIG_FILE="board/cvmrdma/cvm/linux.config"
BR2_PACKAGE_BUSYBOX_SHOW_OTHERS=y
BR2_PACKAGE_GDB=y # For gdbserver
BR2_PACKAGE_MTR=y
BR2_PACKAGE_WIREGUARD_TOOLS=y
BR2_PACKAGE_TMUX=y
# BR2_PACKAGE_RDMA_CORE_CVMRDMA is not set
BR2_PACKAGE_RDMA_CORE=y
BR2_TARGET_ROOTFS_EXT2=y
BR2_TARGET_ROOTFS_EXT2_SIZE="256M"
# BR2_TARGET_ROOTFS_TAR is not set
BR2_PACKAGE_HOST_ENVIRONMENT_SETUP=y
BR2_PACKAGE_HOST_GENIMAGE=y
BR2_PACKAGE_HOST_QEMU=y
BR2_PACKAGE_HOST_QEMU_SYSTEM_MODE=y
BR2_PACKAGE_HOST_QEMU_VIRTFS=y
```

## configs/cvmrdma_sev_defconfig
```kconfig
BR2_x86_64=y
BR2_x86_x86_64_v3=y
BR2_TOOLCHAIN_EXTERNAL=y
BR2_TOOLCHAIN_EXTERNAL_PREINSTALLED=y
BR2_TOOLCHAIN_EXTERNAL_PATH="${HOME}/cvmrdma-install/toolchain-x86-64-v3"
BR2_PACKAGE_HOST_GDB=y
BR2_PACKAGE_HOST_GDB_TUI=y
BR2_PACKAGE_HOST_GDB_PYTHON3=y
BR2_GDB_VERSION_13=y
BR2_CCACHE=y
BR2_ROOTFS_MERGED_USR=y
BR2_SYSTEM_BIN_SH_BASH=y
BR2_SYSTEM_DEFAULT_PATH="/bin:/sbin:/usr/bin:/usr/sbin"
BR2_ENABLE_LOCALE_WHITELIST="C.UTF-8"
BR2_GENERATE_LOCALE="C.UTF-8"
BR2_ROOTFS_OVERLAY="board/cvmrdma/cvm/rootfs_overlay"
BR2_ROOTFS_POST_BUILD_SCRIPT="board/cvmrdma/cvm/post-build.sh"
BR2_ROOTFS_POST_IMAGE_SCRIPT="board/cvmrdma/cvm/post-image.sh"
BR2_LINUX_KERNEL=y
BR2_LINUX_KERNEL_CUSTOM_GIT=y
BR2_LINUX_KERNEL_CUSTOM_REPO_URL="https://github.com/AMDESE/linux.git"
BR2_LINUX_KERNEL_CUSTOM_REPO_VERSION="ad9c0bf475ecde466a065af44fc94918f109c4c9"
BR2_LINUX_KERNEL_USE_CUSTOM_CONFIG=y
BR2_LINUX_KERNEL_CUSTOM_CONFIG_FILE="board/cvmrdma/cvm/linux-sev.config"
BR2_PACKAGE_BUSYBOX_SHOW_OTHERS=y
BR2_PACKAGE_OPENSM=y
BR2_PACKAGE_PCIUTILS=y
BR2_PACKAGE_MTR=y
BR2_PACKAGE_WIREGUARD_TOOLS=y
BR2_PACKAGE_IPERF3=y
BR2_PACKAGE_TMUX=y
BR2_PACKAGE_NETPERF=y
# BR2_PACKAGE_MSTFLINT=y
#BR2_PACKAGE_RDMA_REDIS=y
BR2_PACKAGE_JEMALLOC=y
BR2_PACKAGE_RDMA_CORE_CVMRDMA_SRC=y
BR2_PACKAGE_RDMA_CORE_CVMRDMA=y
BR2_TARGET_ROOTFS_EXT2=y
BR2_TARGET_ROOTFS_EXT2_SIZE="2048M"
# BR2_TARGET_ROOTFS_TAR is not set
BR2_TARGET_EDK2=y
BR2_EDK2_AMD_SEV_SNP=y
BR2_PACKAGE_HOST_ENVIRONMENT_SETUP=y
BR2_PACKAGE_HOST_GENIMAGE=y
BR2_PACKAGE_GDB=y
BR2_PACKAGE_GDB_DEBUGGER=y
BR2_PACKAGE_BPFTOOL=y
BR2_PACKAGE_LIBSIGSEGV=y
BR2_PACKAGE_BINUTILS=y
BR2_PACKAGE_PWNDBG=y
BR2_PACKAGE_ETHTOOL=y
BR2_TOOLCHAIN_EXTRA_LIBS="libasan liblsan libtsan libubsan"
```

## package/aegis/Config.in
```kconfig
config BR2_PACKAGE_AEGIS
    bool "aegis"
    help
        https://github.com/jedisct1/libaegis
```

## package/cvmrdma/Config.in
```kconfig
source "package/cvmrdma/mstflint/Config.in"
source "package/cvmrdma/opensm/Config.in"
source "package/cvmrdma/rdma-core/Config.in"
source "package/cvmrdma/rdma-core-cvmrdma/Config.in"
source "package/cvmrdma/rdma-core-virtual/Config.in"
source "package/cvmrdma/rdma-redis/Config.in"
source "package/cvmrdma/ucx/Config.in"
source "package/tracer_lapic/Config.in" 
source "package/cvmrdma/cvmrdma-manager/Config.in"
```

## package/cvmrdma/cvmrdma-bench/Config.in
```kconfig
config BR2_PACKAGE_CVMRDMA_BENCH
    bool "rdma-bench"
    depends on BR2_PACKAGE_HAS_RDMA_CORE_VIRTUAL
    select BR2_PACKAGE_LIBSODIUM
    select BR2_PACKAGE_AEGIS
    help
        A simple RDMA test app.
```

## package/cvmrdma/cvmrdma-manager/Config.in
```kconfig
config BR2_PACKAGE_CVMRDMA_MANAGER
    bool "rdma-bench"
    depends on BR2_PACKAGE_HAS_RDMA_CORE_VIRTUAL
    help
        A simple RDMA manager app.
```

## package/cvmrdma/mstflint/Config.in
```kconfig
config BR2_PACKAGE_MSTFLINT
    bool "mstflint"
    help
        https://github.com/Mellanox/mstflint
```

## package/cvmrdma/opensm/Config.in
```kconfig
config BR2_PACKAGE_OPENSM
    bool "opensm"
    depends on BR2_PACKAGE_HAS_RDMA_CORE_VIRTUAL
    help
        OpenSM Infiniband manager.
```

## package/cvmrdma/rdma-core-cvmrdma-src/Config.in
```kconfig
config BR2_PACKAGE_RDMA_CORE_CVMRDMA_SRC
	bool "rdma-core-cvmrdma-src"
	help
	  The CVM-aware RDMA core provider.
```

## package/cvmrdma/rdma-core-cvmrdma/Config.in
```kconfig
config BR2_PACKAGE_RDMA_CORE_CVMRDMA
	bool "rdma-core-cvmrdma"
	depends on BR2_USE_MMU # fork() used in rstream example
	depends on BR2_TOOLCHAIN_HAS_SYNC_4
	depends on BR2_TOOLCHAIN_HEADERS_AT_LEAST_3_4  # iproute2
	depends on !BR2_STATIC_LIBS # dlopen()
	depends on BR2_TOOLCHAIN_HAS_THREADS_NPTL
	select BR2_PACKAGE_IPROUTE2  # runtime
	select BR2_PACKAGE_LIBNL
	select BR2_PACKAGE_HAS_RDMA_CORE_VIRTUAL # mark as available
	help
	  The CVM-aware RDMA core provider.

if BR2_PACKAGE_RDMA_CORE_CVMRDMA
config BR2_PACKAGE_PROVIDES_RDMA_CORE_VIRTUAL
    default "rdma-core-cvmrdma"
endif
```

## package/cvmrdma/rdma-core-virtual/Config.in
```kconfig
config BR2_PACKAGE_HAS_RDMA_CORE_VIRTUAL
	bool

config BR2_PACKAGE_PROVIDES_RDMA_CORE_VIRTUAL
	depends on BR2_PACKAGE_HAS_RDMA_CORE_VIRTUAL
	string

comment "rdma-core needs a toolchain w/ headers >= 3.4, NPTL, dynamic library"
	depends on BR2_USE_MMU
	depends on BR2_TOOLCHAIN_HAS_SYNC_4
	depends on !BR2_TOOLCHAIN_HEADERS_AT_LEAST_3_4 \
		|| !BR2_TOOLCHAIN_HAS_THREADS_NPTL || BR2_STATIC_LIBS
```

## package/cvmrdma/rdma-redis/Config.in
```kconfig
config BR2_PACKAGE_RDMA_REDIS
    bool "rdma-redis"
    depends on BR2_PACKAGE_HAS_RDMA_CORE_VIRTUAL
    help
        https://github.com/zzaoen/RdmaAcceleratingRedis
```

## package/cvmrdma/ucx/Config.in
```kconfig
config BR2_PACKAGE_UCX
    bool "ucx"
    depends on BR2_PACKAGE_HAS_RDMA_CORE_VIRTUAL
    help
        Unified Communication X (UCX) is an award winning,
        optimized production proven-communication framework
        for modern, high-bandwidth and low-latency networks.
```

## package/pwndbg/Config.in
```kconfig
config BR2_PACKAGE_PWNDBG
    bool "pwndbg"
    help
        https://github.com/pwndbg/pwndbg
```

## package/tracer_lapic/Config.in
```kconfig
config BR2_PACKAGE_TRACER_LAPIC
    bool "lapic_trace kernel module"
    help
      Kernel module to trace LAPIC writes using kprobes.
```
